## main/Kconfig.projbuild
```kconfig
menu "Application Configuration"
	config ESP32_WAND_SSID
		string "AP WiFi SSID"
		default "ESP32_WAND_CONFIG"
		help
			SSID (network name) to connect to.

	config ESP32_WAND_PASS
		string "AP WiFi Password"
		default "12345678"
		help
			WiFi password (WPA or WPA2) to use.

	config WAND_MDNS_HOSTNAME
		string "MDNS_HOSTNAME"
		default "wand-esp32"

	config WIFI_SCAN_LIST_SIZE
		int "WIFI_SCAN_LIST_SIZE"
		default 20

	config ESP_MAXIMUM_RETRY
		int "Maximum retry"
		default 5
		help
			Set the Maximum retry to avoid station reconnecting to the AP unlimited when the AP is really inexistent.

endmenu
```
